/dts-v1/;
/plugin/;

#include "yupik-qrd.dtsi"
#include "yupik-abra-common-overlay.dtsi"
#include "nothing-spacewar-pinctrl.dtsi"
#include "nothing-spacewar-common.dtsi"
#include "nothing-spacewar-pmic-overlay.dtsi"
#include "nothing-spacewar-qrd.dtsi"
#include "nothing-spacewar-audio-overlay.dtsi"
#include "nothing-spacewar-thermal.dtsi"

/ {
	model = "Qualcomm Technologies, Inc. Nothing Phone (1)";
	compatible = "qcom,yupik-idp", "qcom,yupik", "qcom,qrd";
	qcom,msm-id = <475 0x10000>, <515 0x10000>;
	qcom,board-id = <0x1000B 0>;
};
