## drivers/fgetpriority/Kconfig
```kconfig
menu "fgetpriority"

config FGETPRIORITY
	tristate "uid filter"
	depends on ARM64 && KALLSYMS
	default y
	help
	  uid filter.

endmenu
```

## drivers/nothing_thermal/Kconfig
```kconfig
#
# Generic thermal sysfs drivers configuration
#

config SIMULATED_NTC_THERMAL
	bool "Nothing simulated NTC shell temperature sensors"
	depends on THERMAL
	help
	  Support for Nothing's simulated NTC shell thermal zones
	  (front/frame/back), driven via /proc/shell-temp writes from
	  the vendor thermal-engine HAL.
```

## drivers/power/Kconfig
```kconfig
# SPDX-License-Identifier: GPL-2.0-only

config USB_TEMP_PROTECT
	bool "To switch charging by usb temperature"
	help
	 Say Y here if we want to use this function

source "drivers/power/avs/Kconfig"
source "drivers/power/reset/Kconfig"
source "drivers/power/supply/Kconfig"
```

## drivers/staging/qcacld-3.0/configs/qca6750_defconfig
```kconfig
CONFIG_CNSS_QCA6750 := y
DEVNAME := qca6750
include $(WLAN_ROOT)/configs/default_defconfig

#Enable Constrained Application Protocol feature
CONFIG_WLAN_FEATURE_COAP := y
```

## kernel/pgo/Kconfig
```kconfig
# SPDX-License-Identifier: GPL-2.0-only
menu "Profile Guided Optimization (PGO) (EXPERIMENTAL)"

config ARCH_SUPPORTS_PGO_CLANG
	bool

config PGO_CLANG
	bool "Enable clang's PGO-based kernel profiling"
	depends on DEBUG_FS
	depends on ARCH_SUPPORTS_PGO_CLANG
	depends on CC_IS_CLANG && CLANG_VERSION >= 190000
	depends on !LTO_CLANG
	depends on !GCOV_KERNEL
	help
	  This option enables clang's PGO (Profile Guided Optimization) based
	  code profiling to better optimize the kernel.

	  If unsure, say N.

	  Run a representative workload on a kernel compiled with this option,
	  mount debugfs and read the raw profile from
	  /sys/kernel/debug/pgo/profraw. Writing anything to
	  /sys/kernel/debug/pgo/reset clears all counters. The raw profile has
	  to be processed with llvm-profdata from the same LLVM release as the
	  compiler that built the kernel:

	    llvm-profdata merge --output=vmlinux.profdata vmlinux.profraw

	  Rebuild the kernel with PGO disabled (and LTO re-enabled if wanted)
	  and KCFLAGS=-fprofile-use=vmlinux.profdata to produce the optimized
	  kernel.

	  Note that a kernel compiled with profiling flags is significantly
	  larger and slower. Only built-in code is profiled; loadable modules
	  are not instrumented. The raw profile layout is private to LLVM and
	  changes between releases, so the build verifies it against the
	  compiler (see kernel/pgo/Makefile).

endmenu
```
